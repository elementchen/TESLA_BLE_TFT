## main/Kconfig.projbuild
```kconfig
menu "Tesla BLE Dashboard"

config OLED_SDA_GPIO
    int "OLED SDA GPIO"
    default 41
    range 0 48
    help
        I2C SDA pin for SSD1306 OLED display

config OLED_SCL_GPIO
    int "OLED SCL GPIO"
    default 42
    range 0 48
    help
        I2C SCL pin for SSD1306 OLED display

config OLED_RESET_GPIO
    int "OLED RESET GPIO"
    default -1
    range -1 48
    help
        Reset pin for SSD1306 OLED display (-1 = not connected)

config TESLA_DASH_USE_REAL_CAR_BLE
    bool "Enable Real Car BLE Connection"
    default y
    help
        If checked, the system will use real Tesla BLE NimBLE radio to search and pair with the vehicle. 
        If unchecked, it will play the mock demo script timeline.

config TESLA_DASH_VIN
    string "Tesla Vehicle VIN (for BLE encryption)"
    default "LRWYGCFS2PC792568"
    help
        Your Tesla vehicle's 17-digit VIN code, used to derive the Bluetooth pairing key schema.

endmenu
```

## sdkconfig.defaults
```kconfig
# ESP32-S3 target
CONFIG_IDF_TARGET_ESP32S3=y

# NimBLE (instead of Bluedroid, saves flash/RAM)
CONFIG_BT_ENABLED=y
CONFIG_BT_NIMBLE_ENABLED=y
CONFIG_BT_BLUEDROID_ENABLED=n
CONFIG_BT_NIMBLE_MAX_CONNECTIONS=1
CONFIG_BT_NIMBLE_MAX_BONDS=0
CONFIG_BT_NIMBLE_MESH=n
CONFIG_BT_NIMBLE_CRYPTO_STACK_MBEDTLS=y
CONFIG_BT_NIMBLE_EXT_ADV=n
CONFIG_BT_NIMBLE_ROLE_CENTRAL=y
CONFIG_BT_NIMBLE_ROLE_PERIPHERAL=n

# FreeRTOS
CONFIG_FREERTOS_HZ=1000

# Larger main task stack for BLE + Tesla protocol
CONFIG_ESP_MAIN_TASK_STACK_SIZE=12288

# C++ exceptions (required by tesla-ble library)
CONFIG_COMPILER_CXX_EXCEPTIONS=y
CONFIG_COMPILER_CXX_EXCEPTIONS_EMG_POOL_SIZE=256

# NimBLE host task stack (must be large enough for GATT callbacks + protobuf)
CONFIG_BT_NIMBLE_HOST_TASK_STACK_SIZE=8192

# Increase NimBLE memory pools for sustained polling
CONFIG_BT_NIMBLE_MSYS_1_BLOCK_COUNT=32
CONFIG_BT_NIMBLE_MSYS_2_BLOCK_COUNT=48
CONFIG_BT_NIMBLE_BLE_ATT_PREFERRED_MTU=256

# Log levels
CONFIG_LOG_DEFAULT_LEVEL_INFO=y
CONFIG_LOG_MAXIMUM_LEVEL_DEBUG=y
CONFIG_BT_NIMBLE_LOG_LEVEL_WARNING=y

# mbedTLS (ECDH key exchange)
CONFIG_MBEDTLS_HKDF_C=y
CONFIG_MBEDTLS_ECDH_C=y

# Flash and PSRAM settings for ESP32-S3-N8R16
CONFIG_ESPTOOLPY_FLASHSIZE_16MB=y
CONFIG_ESPTOOLPY_FLASHMODE_QIO=y
CONFIG_ESP_DEFAULT_CPU_FREQ_MHZ_240=y
CONFIG_SPIRAM=y
CONFIG_SPIRAM_MODE_OCT=y
CONFIG_SPIRAM_SPEED_80M=y
CONFIG_SPIRAM_MALLOC_ALWAYSINTERNAL=512
CONFIG_SPIRAM_MALLOC_RESERVE_INTERNAL=65536
CONFIG_SPIRAM_MEMTEST=n
CONFIG_ESP32S3_INSTRUCTION_CACHE_32KB=y
CONFIG_ESP32S3_DATA_CACHE_LINE_64B=y
```
